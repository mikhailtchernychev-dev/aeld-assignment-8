## base_external/package/aesd-char-driver/Config.in
```kconfig
config BR2_PACKAGE_AESD_CHAR_DRIVER
	bool "aesd-char-ddrver"
	help
	  Includes aesd char driver implementation
```

## base_external/package/ldd/Config.in
```kconfig
config BR2_PACKAGE_LDD
	bool "ldd"
	help
	  Includes simple kernel modules from ldd3 project
```
